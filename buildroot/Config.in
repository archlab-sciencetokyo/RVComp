## buildroot/Config.in
```kconfig
# SPDX-License-Identifier: GPL-2.0
#
# Copyright (c) 2026 Archlab, Science Tokyo

source "$BR2_EXTERNAL_RVCOMP_PATH/package/rvcomp-ethernet/Config.in"
source "$BR2_EXTERNAL_RVCOMP_PATH/package/rvcomp-mmc/Config.in"
source "$BR2_EXTERNAL_RVCOMP_PATH/package/rvcomp-bootfiles/Config.in"
source "$BR2_EXTERNAL_RVCOMP_PATH/package/rvcomp-camera/Config.in"
source "$BR2_EXTERNAL_RVCOMP_PATH/package/rvcomp-camtx/Config.in"
```

## buildroot/configs/mmc_defconfig
```kconfig
# SPDX-License-Identifier: GPL-2.0

BR2_riscv=y
BR2_riscv_custom=y
BR2_RISCV_ISA_RVM=y
BR2_RISCV_ISA_RVA=y
BR2_RISCV_32=y
BR2_BINUTILS_VERSION_2_45_X=y
BR2_GCC_VERSION_15_X=y
BR2_TOOLCHAIN_BUILDROOT_CXX=y
BR2_TOOLCHAIN_BUILDROOT_FORTRAN=y
BR2_GLOBAL_PATCH_DIR="$(BR2_EXTERNAL_RVCOMP_PATH)/patches"
BR2_ROOTFS_OVERLAY="$(BR2_EXTERNAL_RVCOMP_PATH)/rootfs_overlay"
# BR2_PACKAGE_OPENSSH is not set
BR2_PACKAGE_E2FSPROGS=y
BR2_PACKAGE_E2FSPROGS_E2FSCK=y
BR2_LINUX_KERNEL=y
BR2_LINUX_KERNEL_USE_CUSTOM_CONFIG=y
BR2_LINUX_KERNEL_CUSTOM_CONFIG_FILE="$(BR2_EXTERNAL_RVCOMP_PATH)/kernel/mmc/defconfig"
BR2_TARGET_ROOTFS_INITRAMFS=y
BR2_TARGET_ROOTFS_CPIO=y
BR2_ROOTFS_POST_IMAGE_SCRIPT="$(BR2_EXTERNAL_RVCOMP_PATH)/scripts/post_image_script.sh"
# BR2_TARGET_ROOTFS_TAR is not set
BR2_TARGET_OPENSBI=y
BR2_TARGET_OPENSBI_CUSTOM_GIT=y
BR2_TARGET_OPENSBI_CUSTOM_REPO_URL="https://github.com/archlab-sciencetokyo/opensbi.git"
BR2_TARGET_OPENSBI_CUSTOM_REPO_VERSION="1.8.1-rvcomp"
BR2_TARGET_OPENSBI_PLAT="rvcpu"
# BR2_TARGET_OPENSBI_INSTALL_DYNAMIC_IMG is not set
# BR2_TARGET_OPENSBI_INSTALL_JUMP_IMG is not set
BR2_TARGET_OPENSBI_INSTALL_PAYLOAD_IMG=y
BR2_TARGET_OPENSBI_ADDITIONAL_VARIABLES="FW_PAYLOAD_PATH=$(BINARIES_DIR)/Image"
BR2_PACKAGE_RVCOMP_ETHERNET=y
BR2_PACKAGE_RVCOMP_MMC=y
BR2_PACKAGE_RVCOMP_CAMERA=y
BR2_PACKAGE_RVCOMP_CAMTX=y
```

## buildroot/configs/uart_defconfig
```kconfig
# SPDX-License-Identifier: GPL-2.0

BR2_riscv=y
BR2_riscv_custom=y
BR2_RISCV_ISA_RVM=y
BR2_RISCV_ISA_RVA=y
BR2_RISCV_32=y
BR2_KERNEL_HEADERS_6_12=y
BR2_GCC_VERSION_14_X=y
BR2_TOOLCHAIN_BUILDROOT_CXX=y
BR2_TOOLCHAIN_BUILDROOT_FORTRAN=y
BR2_LINUX_KERNEL=y
BR2_LINUX_KERNEL_USE_CUSTOM_CONFIG=y
BR2_LINUX_KERNEL_CUSTOM_CONFIG_FILE="$(BR2_EXTERNAL_RVCOMP_PATH)/kernel/uart/defconfig"
BR2_TARGET_ROOTFS_INITRAMFS=y
# BR2_TARGET_ROOTFS_TAR is not set
BR2_TARGET_OPENSBI=y
BR2_TARGET_OPENSBI_CUSTOM_GIT=y
BR2_TARGET_OPENSBI_CUSTOM_REPO_URL="git@github.com:archlab-sciencetokyo/opensbi.git"
BR2_TARGET_OPENSBI_CUSTOM_REPO_VERSION="1.5-rvcomp"
BR2_TARGET_OPENSBI_PLAT="rvcpu"
# BR2_TARGET_OPENSBI_INSTALL_DYNAMIC_IMG is not set
# BR2_TARGET_OPENSBI_INSTALL_JUMP_IMG is not set
BR2_TARGET_OPENSBI_INSTALL_PAYLOAD_IMG=y
BR2_TARGET_OPENSBI_ADDITIONAL_VARIABLES="FW_PAYLOAD_PATH=$(BINARIES_DIR)/Image"
```

## buildroot/kernel/mmc/defconfig
```kconfig
# SPDX-License-Identifier: GPL-2.0

# CONFIG_LOCALVERSION_AUTO is not set
# CONFIG_CROSS_MEMORY_ATTACH is not set
CONFIG_BLK_DEV_INITRD=y
CONFIG_INITRAMFS_SOURCE="${BINARIES_DIR}/rootfs.cpio"
# CONFIG_RD_BZIP2 is not set
# CONFIG_RD_LZMA is not set
# CONFIG_RD_XZ is not set
# CONFIG_RD_LZO is not set
# CONFIG_RD_LZ4 is not set
# CONFIG_RD_ZSTD is not set
CONFIG_INITRAMFS_COMPRESSION_NONE=y
# CONFIG_INITRAMFS_PRESERVE_MTIME is not set
CONFIG_CC_OPTIMIZE_FOR_SIZE=y
CONFIG_FRAME_POINTER=y
CONFIG_EXPERT=y
CONFIG_MULTIUSER=y
# CONFIG_SYSFS_SYSCALL is not set
# CONFIG_FHANDLE is not set
# CONFIG_POSIX_TIMERS is not set
# CONFIG_BUG is not set
# CONFIG_ELF_CORE is not set
# CONFIG_EPOLL is not set
# CONFIG_SIGNALFD is not set
# CONFIG_TIMERFD is not set
# CONFIG_EVENTFD is not set
# CONFIG_SHMEM is not set
# CONFIG_AIO is not set
# CONFIG_IO_URING is not set
# CONFIG_ADVISE_SYSCALLS is not set
# CONFIG_MEMBARRIER is not set
# CONFIG_RSEQ is not set
CONFIG_KALLSYMS=y
CONFIG_NONPORTABLE=y
CONFIG_ARCH_RV32I=y
CONFIG_CMODEL_MEDANY=y
# CONFIG_RISCV_ISA_C is not set
# CONFIG_RISCV_ISA_ZAWRS is not set
# CONFIG_RISCV_ISA_ZBA is not set
# CONFIG_RISCV_ISA_ZBB is not set
# CONFIG_RISCV_ISA_ZBC is not set
# CONFIG_RISCV_ISA_ZICBOM is not set
# CONFIG_RISCV_ISA_ZICBOZ is not set
# CONFIG_FPU is not set
CONFIG_RISCV_EMULATED_UNALIGNED_ACCESS=y
# CONFIG_RISCV_ISA_VENDOR_EXT_ANDES is not set
CONFIG_HZ_100=y
# CONFIG_EFI is not set
CONFIG_ARCH_MMAP_RND_BITS=17
# CONFIG_STRICT_KERNEL_RWX is not set
# CONFIG_GCC_PLUGINS is not set
CONFIG_BINFMT_MISC=y
CONFIG_SLUB_TINY=y

# Network support
CONFIG_NET=y
CONFIG_PACKET=y
CONFIG_UNIX=y
CONFIG_INET=y
CONFIG_IP_MULTICAST=y
CONFIG_IP_PNP=y
CONFIG_IP_PNP_DHCP=y
# CONFIG_IPV6 is not set
CONFIG_TCP_CONG_CUBIC=y
CONFIG_DEFAULT_TCP_CONG="cubic"

# Ethernet support
CONFIG_NETDEVICES=y
CONFIG_ETHERNET=y
# CONFIG_NET_VENDOR_ALACRITECH is not set
# CONFIG_NET_VENDOR_AMAZON is not set
# CONFIG_NET_VENDOR_AMD is not set
# CONFIG_NET_VENDOR_AQUANTIA is not set
# CONFIG_NET_VENDOR_ARC is not set
# CONFIG_NET_VENDOR_CADENCE is not set
# CONFIG_NET_VENDOR_BROADCOM is not set
# CONFIG_NET_VENDOR_CAVIUM is not set
# CONFIG_NET_VENDOR_CORTINA is not set
# CONFIG_NET_VENDOR_EZCHIP is not set
# CONFIG_NET_VENDOR_GOOGLE is not set
# CONFIG_NET_VENDOR_HUAWEI is not set
# CONFIG_NET_VENDOR_INTEL is not set
# CONFIG_NET_VENDOR_LITEX is not set
# CONFIG_NET_VENDOR_MARVELL is not set
# CONFIG_NET_VENDOR_MELLANOX is not set
# CONFIG_NET_VENDOR_MICREL is not set
# CONFIG_NET_VENDOR_MICROCHIP is not set
# CONFIG_NET_VENDOR_MICROSEMI is not set
# CONFIG_NET_VENDOR_MICROSOFT is not set
# CONFIG_NET_VENDOR_NETRONOME is not set
# CONFIG_NET_VENDOR_NI is not set
# CONFIG_NET_VENDOR_PENSANDO is not set
# CONFIG_NET_VENDOR_QUALCOMM is not set
# CONFIG_NET_VENDOR_RENESAS is not set
# CONFIG_NET_VENDOR_ROCKER is not set
# CONFIG_NET_VENDOR_SAMSUNG is not set
# CONFIG_NET_VENDOR_SEEQ is not set
# CONFIG_NET_VENDOR_SOLARFLARE is not set
# CONFIG_NET_VENDOR_SOCIONEXT is not set
# CONFIG_NET_VENDOR_STMICRO is not set
# CONFIG_NET_VENDOR_SYNOPSYS is not set
# CONFIG_NET_VENDOR_VERTEXCOM is not set
# CONFIG_NET_VENDOR_VIA is not set
# CONFIG_NET_VENDOR_XILINX is not set

CONFIG_DEVTMPFS=y
CONFIG_DEVTMPFS_MOUNT=y
CONFIG_SERIAL_EARLYCON_RISCV_SBI=y
CONFIG_HVC_RISCV_SBI=y
CONFIG_HID_A4TECH=y
CONFIG_HID_BELKIN=y
CONFIG_HID_CHERRY=y
CONFIG_HID_CYPRESS=y
CONFIG_HID_EZKEY=y
CONFIG_HID_ITE=y
CONFIG_HID_KENSINGTON=y
CONFIG_HID_REDRAGON=y
CONFIG_HID_MICROSOFT=y
CONFIG_HID_MONTEREY=y
# Filesystem support
CONFIG_EXT2_FS=y
CONFIG_JBD2=y
CONFIG_EXT4_FS=y

CONFIG_NLS=y
CONFIG_CRYPTO=y
CONFIG_CRYPTO_CRC32C=y
CONFIG_CRC16=y
CONFIG_XZ_DEC=y
CONFIG_PRINTK_TIME=y
CONFIG_FRAME_WARN=2048
CONFIG_DEBUG_MEMORY_INIT=y
# CONFIG_FTRACE is not set
```

## buildroot/kernel/uart/defconfig
```kconfig
# SPDX-License-Identifier: GPL-2.0

# CONFIG_LOCALVERSION_AUTO is not set
# CONFIG_CROSS_MEMORY_ATTACH is not set
CONFIG_BLK_DEV_INITRD=y
CONFIG_INITRAMFS_SOURCE="${BR_BINARIES_DIR}/rootfs.cpio"
# CONFIG_RD_BZIP2 is not set
# CONFIG_RD_LZMA is not set
# CONFIG_RD_XZ is not set
# CONFIG_RD_LZO is not set
# CONFIG_RD_LZ4 is not set
# CONFIG_RD_ZSTD is not set
CONFIG_INITRAMFS_COMPRESSION_NONE=y
# CONFIG_INITRAMFS_PRESERVE_MTIME is not set
CONFIG_CC_OPTIMIZE_FOR_SIZE=y
CONFIG_EXPERT=y
# CONFIG_MULTIUSER is not set
# CONFIG_SYSFS_SYSCALL is not set
# CONFIG_FHANDLE is not set
# CONFIG_POSIX_TIMERS is not set
# CONFIG_BUG is not set
# CONFIG_ELF_CORE is not set
# CONFIG_EPOLL is not set
# CONFIG_SIGNALFD is not set
# CONFIG_TIMERFD is not set
# CONFIG_EVENTFD is not set
# CONFIG_SHMEM is not set
# CONFIG_AIO is not set
# CONFIG_IO_URING is not set
# CONFIG_ADVISE_SYSCALLS is not set
# CONFIG_MEMBARRIER is not set
# CONFIG_RSEQ is not set
# CONFIG_KALLSYMS is not set
CONFIG_NONPORTABLE=y
CONFIG_ARCH_RV32I=y
CONFIG_CMODEL_MEDANY=y
# CONFIG_RISCV_ISA_C is not set
# CONFIG_RISCV_ISA_ZAWRS is not set
# CONFIG_RISCV_ISA_ZBA is not set
# CONFIG_RISCV_ISA_ZBB is not set
# CONFIG_RISCV_ISA_ZBC is not set
# CONFIG_RISCV_ISA_ZICBOM is not set
# CONFIG_RISCV_ISA_ZICBOZ is not set
# CONFIG_FPU is not set
CONFIG_RISCV_EMULATED_UNALIGNED_ACCESS=y
# CONFIG_RISCV_ISA_VENDOR_EXT_ANDES is not set
CONFIG_HZ_100=y
# CONFIG_EFI is not set
CONFIG_ARCH_MMAP_RND_BITS=17
# CONFIG_STRICT_KERNEL_RWX is not set
# CONFIG_GCC_PLUGINS is not set
CONFIG_BINFMT_MISC=y
CONFIG_SLUB_TINY=y
CONFIG_DEVTMPFS=y
CONFIG_DEVTMPFS_MOUNT=y
CONFIG_SERIAL_EARLYCON_RISCV_SBI=y
CONFIG_HVC_RISCV_SBI=y
CONFIG_HID_A4TECH=y
CONFIG_HID_BELKIN=y
CONFIG_HID_CHERRY=y
CONFIG_HID_CYPRESS=y
CONFIG_HID_EZKEY=y
CONFIG_HID_ITE=y
CONFIG_HID_KENSINGTON=y
CONFIG_HID_REDRAGON=y
CONFIG_HID_MICROSOFT=y
CONFIG_HID_MONTEREY=y
CONFIG_NLS=y
CONFIG_CRYPTO=y
CONFIG_CRYPTO_CRC32C=y
CONFIG_CRC16=y
CONFIG_XZ_DEC=y
CONFIG_PRINTK_TIME=y
CONFIG_FRAME_WARN=2048
CONFIG_DEBUG_MEMORY_INIT=y
# CONFIG_FTRACE is not set
```

## buildroot/package/rvcomp-bootfiles/Config.in
```kconfig
# SPDX-License-Identifier: GPL-2.0
#
# Copyright (c) 2026 Archlab, Science Tokyo

config BR2_PACKAGE_RVCOMP_BOOTFILES
	bool
	default y
	help
	  Install the initramfs dispatcher and optional early boot hooks
	  for RVCOMP platform bring-up.
```

## buildroot/package/rvcomp-camera/Config.in
```kconfig
# SPDX-License-Identifier: GPL-2.0
#
# Copyright (c) 2026 Archlab, Science Tokyo

config BR2_PACKAGE_RVCOMP_CAMERA
	bool "rvcomp-camera"
	depends on BR2_LINUX_KERNEL
	help
	  Camera driver for RVComp SoC.

	  This driver exposes /dev/rvcomp_cam0 and provides read/poll/ioctl
	  for Gray8 frame capture through MMIO polling.
```

## buildroot/package/rvcomp-camtx/Config.in
```kconfig
# SPDX-License-Identifier: GPL-2.0
#
# Copyright (c) 2026 Archlab, Science Tokyo

config BR2_PACKAGE_RVCOMP_CAMTX
	bool "rvcomp-camtx"
	help
	  Camera frame UDP sender for RVComp.

	  cam_tx reads /dev/rvcomp_cam0 and transmits chunked Gray8 frames
	  over UDP to a host relay.
```

## buildroot/package/rvcomp-ethernet/Config.in
```kconfig
# SPDX-License-Identifier: GPL-2.0
#
# Copyright (c) 2026 Archlab, Science Tokyo

config BR2_PACKAGE_RVCOMP_ETHERNET
	bool "rvcomp-ethernet"
	depends on BR2_LINUX_KERNEL
	help
	  Ethernet driver for RVCOMP SoC.

	  This driver supports the custom Ethernet MAC used in the
	  RVComp RISC-V SoC.

	  https://archlab-sciencetokyo.github.io/RVComp-doc
```

## buildroot/package/rvcomp-mmc/Config.in
```kconfig
# SPDX-License-Identifier: GPL-2.0
#
# Copyright (c) 2026 Archlab, Science Tokyo

config BR2_PACKAGE_RVCOMP_MMC
	bool "rvcomp-mmc"
	depends on BR2_LINUX_KERNEL
	help
	  MMC block device driver for RVCOMP SoC.

	  This driver supports the custom MMC controller used in the
	  RVComp RISC-V SoC, exposing it as a Linux block device.

	  https://archlab-sciencetokyo.github.io/RVComp-doc
```
